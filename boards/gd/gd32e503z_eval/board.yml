## boards/gd/gd32e503z_eval/board.yml
```yaml
board:
  name: gd32e503z_eval
  full_name: GD32E503Z-EVAL
  vendor: gd
  socs:
    - name: gd32e503
```

## soc/gd/gd32/gd32e50x/Kconfig.soc
```kconfig
# Copyright (c) 2022, Teslabs Engineering S.L.
# SPDX-License-Identifier: Apache-2.0

config SOC_SERIES_GD32E50X
	bool
	select SOC_FAMILY_GD_GD32
	help
	  Enable support for GigaDevice GD32E50X MCU series

config SOC_SERIES
	default "gd32e50x" if SOC_SERIES_GD32E50X

rsource "*/Kconfig.soc"
```

## soc/gd/gd32/gd32e50x/gd32e503/Kconfig.soc
```kconfig
# Copyright (c) 2022, Teslabs Engineering S.L.
# SPDX-License-Identifier: Apache-2.0

config SOC_GD32E503
	bool
	select SOC_SERIES_GD32E50X

config SOC
	default "gd32e503" if SOC_GD32E503
```
